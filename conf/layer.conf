## conf/layer.conf
```bitbake
BBPATH .= ":${LAYERDIR}"
BBFILES += "\
            ${LAYERDIR}/recipes-*/*/*.bb \
            ${LAYERDIR}/recipes-*/*/*.bbappend \
           "

BBFILE_COLLECTIONS += "vexa15"
BBFILE_PATTERN_vexa15 := "^${LAYERDIR}/"
BBFILE_PRIORITY_vexa15 = "5"
```

## conf/machine/vexa15.conf
```bitbake
#@TYPE: Machine
#@Name: Versatile Express A15 based devices
#@DESCRIPTION: Machine configuration for the Versatile Express A15 based devices including big.LITTLE

PREFERRED_PROVIDER_virtual/kernel = "linux-ael"
PREFERRED_PROVIDER_kernel-base = "linux-ael"
KERNEL_IMAGETYPE = "zImage"

SERIAL_CONSOLE = "38400n8 ttyAMA0"
```
